// These arguments were used when this file was generated. They will be automatically applied on subsequent loads 
// via the GUI or CLI invocations. Run CLI with '--help' for additional information on how to override these arguments.
// @cliArgs --board "/ti/boards/CC26X2R1_LAUNCHXL" --product "simplelink_cc13x2_26x2_sdk@3.40.00.02"
// @versions {"data":"2019103101","timestamp":"2019103101","tool":"1.3.1030","templates":"2019103101"}

var RTOS = scripting.addModule("/ti/drivers/RTOS");
var GPIO = scripting.addModule("/ti/drivers/GPIO");
var GPIO1 = GPIO.addInstance();
var I2C = scripting.addModule("/ti/drivers/I2C", {}, false);
var I2C1 = I2C.addInstance();
var Power = scripting.addModule("/ti/drivers/Power", {}, false);
var CCFG = scripting.addModule("/ti/devices/CCFG", {}, false);
// Name
CCFG.ccfgTemplate.$name = "ti_devices_CCFGTemplate0";
var Board = scripting.addModule("/ti/drivers/Board", {}, false);
var DriverLib = scripting.addModule("/ti/devices/DriverLib", {}, false);
// Use Hardware - Select the hardware to use, or 'None' to use available header pins
GPIO1.$hardware = system.deviceData.board.components.LED_RED;
// Name - The C/C++ identifier used in applications as the index parameter passed to GPIO runtime APIs
GPIO1.$name = "CONFIG_GPIO_LED_0";
// Name
GPIO1.pinInstance.$name = "CONFIG_PIN_0";
// Name - The C/C++ identifier used in applications as the index parameter passed to I2C runtime APIs
I2C1.$name = "CONFIG_I2C_0";
// Name
I2C1.i2c.$name = "MyI2C1";
// Name
I2C1.sdaPinInstance.$name = "CONFIG_PIN_1";
// Pull - Pull up/down
I2C1.sdaPinInstance.pull = "Pull Up";
// Name
I2C1.clkPinInstance.$name = "CONFIG_PIN_2";
// Mode
I2C1.clkPinInstance.mode = "Input";
// Pull - Pull up/down
I2C1.clkPinInstance.pull = "Pull Up";
// Suggest solution
GPIO1.gpioPin.$suggestSolution = "11";
// Suggest solution
I2C1.i2c.$suggestSolution = "I2C0";
// Suggest solution
I2C1.i2c.sdaPin.$suggestSolution = "10";
// Suggest solution
I2C1.i2c.sclPin.$suggestSolution = "9";
